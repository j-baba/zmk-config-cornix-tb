#include <input/processors.dtsi>
#include <dt-bindings/zmk/input_transform.h>

// Split input configuration (central side - receives trackball data from peripheral)
/{
    split_inputs {
        #address-cells = <1>;
        #size-cells = <0>;

        trackball_split: trackball_split@0 {
            compatible = "zmk,input-split";
            reg = <0>;
        };
    };

    trackball_listener: trackball_listener {
        compatible = "zmk,input-listener";
        device = <&trackball_split>;
        status = "okay";

        // Auto-mouse layer: activates layer 3 (MOUSE) when trackball moves, 600ms timeout
        // TEMPORARY DISABLED: Need to investigate why it blocks trackball input
        // input-processors = <&zip_temp_layer 3 600>;

        // If you need to invert X/Y axes, uncomment and add transforms:
        // input-processors = <&zip_xy_transform (INPUT_TRANSFORM_X_INVERT | INPUT_TRANSFORM_Y_INVERT)>;
    };
};
