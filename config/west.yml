## config/west.yml
```yaml
manifest:
  remotes:
    - name: zmkfirmware
      url-base: https://github.com/zmkfirmware
    - name: hitsmaxft
      url-base: https://github.com/hitsmaxft
    - name: sekigon-gonnoc
      url-base: https://github.com/sekigon-gonnoc
    - name: urob
      url-base: https://github.com/urob
    - name: caksoylar
      url-base: https://github.com/caksoylar
  projects:
    - name: zmk
      remote: zmkfirmware
      revision: v0.3
      import: app/west.yml
    - name: zmk-keyboard-cornix
      remote: hitsmaxft
      revision: v2.6.8
    - name: zmk-driver-paw3222
      remote: sekigon-gonnoc
      revision: main
    - name: zmk-helpers
      remote: urob
      revision: main
    - name: zmk-rgbled-widget
      remote: hitsmaxft
      revision: main
  self:
    path: config
```
